#include QMK_KEYBOARD_H

// ═══════════════════════════════════════════════════════════════════════════
//  LAYERS
// ═══════════════════════════════════════════════════════════════════════════
enum layers {
    _MEDIA = 0,
    _GIF,
};

// ═══════════════════════════════════════════════════════════════════════════
//  CUSTOM KEYCODES
// ═══════════════════════════════════════════════════════════════════════════
enum custom_keycodes {
    KC_LAYER_TOG = SAFE_RANGE,  // R1C2 – capslock-style layer toggle
};

// ═══════════════════════════════════════════════════════════════════════════
//  GIF / ANIMATION STATE
//  active_gif:
//    -1  = nothing playing (layer 1, or idle on layer 2)
//     0  = R0C0 animation (walking character, 6 frames)
//     1  = R0C1 bongo cat (2 frames)
//     2  = R1C0 text scroll (4 frames)
//     3  = R1C1 static anydesk (1 frame)
// ═══════════════════════════════════════════════════════════════════════════
static int8_t   active_gif   = -1;
static uint8_t  frame_idx    = 0;
static uint32_t last_frame_t = 0;

// Bongo cat also shows frame 1 when OTHER buttons (not R0C1) are pressed
static bool bongo_other_pressed = false;

// ─── frame timing ──────────────────────────────────────────────────────────
// GIFs 0 and 3 animate at 3 fps → 333 ms per frame
// GIF 1 (bongo) switches on keypress, no timer
// GIF 2 (text)  animates at 3 fps
#define ANIM_MS 333


// ═══════════════════════════════════════════════════════════════════════════
//  BITMAPS  (128×32 px — all PROGMEM)
// ═══════════════════════════════════════════════════════════════════════════

// ── GIF 0: R0C0 — walking character (6 frames) ────────────────────────────
static const unsigned char PROGMEM gif0_f0[] = {
    0x00, 0x00, 0x00, 0x00, 0x00, 0x00, 0x00, 0x00, 0x00, 0x00, 0x00, 0x00, 0x00, 0x00, 0x00, 0x00,
    0x00, 0x00, 0x00, 0x00, 0x00, 0x00, 0x00, 0x00, 0x00, 0x00, 0x00, 0x00, 0x00, 0x00, 0x00, 0x00,
    0x00, 0x00, 0x00, 0x00, 0x00, 0x00, 0x00, 0x00, 0x00, 0x00, 0x00, 0x00, 0x00, 0x00, 0x00, 0x00,
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    0x00, 0x00, 0x00, 0x00, 0x00, 0x00, 0x00, 0x00, 0x00, 0x00, 0x00, 0x00, 0x00, 0x00, 0x00, 0x00
};

static const unsigned char PROGMEM gif0_f1[] = {
    0x00, 0x00, 0x00, 0x00, 0x00, 0x00, 0x00, 0x00, 0x00, 0x00, 0x00, 0x00, 0x00, 0x00, 0x00, 0x00,
    0x00, 0x00, 0x00, 0x07, 0x9e, 0x00, 0x00, 0x00, 0x00, 0x00, 0x00, 0x00, 0x00, 0x00, 0x00, 0x00,
    0x00, 0x00, 0x00, 0x0c, 0xb2, 0x00, 0x00, 0x00, 0x00, 0x00, 0x00, 0x00, 0x00, 0x00, 0x00, 0x00,
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    0x00, 0x00, 0x00, 0x00, 0x00, 0x00, 0x00, 0x00, 0x00, 0x00, 0x00, 0x00, 0x00, 0x00, 0x00, 0x00
};

static const unsigned char PROGMEM gif0_f2[] = {
    0x00, 0x00, 0x00, 0x00, 0x00, 0x00, 0x00, 0x00, 0x00, 0x00, 0x00, 0x00, 0x00, 0x00, 0x00, 0x00,
    0x00, 0x00, 0x00, 0x00, 0x00, 0x00, 0x19, 0x64, 0x00, 0x00, 0x00, 0x00, 0x00, 0x00, 0x00, 0x00,
    0x00, 0x00, 0x00, 0x00, 0x00, 0x00, 0x10, 0xc2, 0x00, 0x00, 0x00, 0x00, 0x00, 0x00, 0x00, 0x00,
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    0x00, 0x00, 0x00, 0x00, 0x00, 0x00, 0x00, 0x00, 0x00, 0x00, 0x00, 0x00, 0x00, 0x00, 0x00, 0x00
};

static const unsigned char PROGMEM gif0_f3[] = {
    0x00, 0x00, 0x00, 0x00, 0x00, 0x00, 0x00, 0x00, 0x00, 0x00, 0x00, 0x00, 0x00, 0x00, 0x00, 0x00,
    0x00, 0x00, 0x00, 0x00, 0x00, 0x00, 0x00, 0x00, 0x00, 0x00, 0x00, 0x00, 0x0f, 0x3c, 0x00, 0x00,
    0x00, 0x00, 0x00, 0x00, 0x00, 0x00, 0x00, 0x00, 0x00, 0x00, 0x00, 0x00, 0x19, 0x64, 0x00, 0x00,
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    0x00, 0x00, 0x00, 0x00, 0x00, 0x00, 0x00, 0x00, 0x00, 0x00, 0x00, 0x00, 0x00, 0x00, 0x00, 0x00
};

static const unsigned char PROGMEM gif0_f4[] = {
    0x00, 0x00, 0x00, 0x00, 0x00, 0x00, 0x00, 0x00, 0x00, 0x00, 0x00, 0x00, 0x00, 0x00, 0x00, 0x00,
    0x00, 0x00, 0x00, 0x00, 0x00, 0x00, 0x00, 0x00, 0x00, 0x00, 0x00, 0x00, 0x00, 0x00, 0x00, 0x00,
    0x00, 0x00, 0x00, 0x00, 0x00, 0x00, 0x00, 0x00, 0x00, 0x00, 0x00, 0x00, 0x00, 0x00, 0x00, 0x00,
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    0x00, 0x00, 0x00, 0x00, 0x00, 0x00, 0x00, 0x00, 0x00, 0x00, 0x00, 0x00, 0x00, 0x00, 0x00, 0x00
};

static const unsigned char PROGMEM gif0_f5[] = {
    0x00, 0x00, 0x00, 0x00, 0x00, 0x00, 0x00, 0x00, 0x00, 0x00, 0x00, 0x00, 0x00, 0x00, 0x00, 0x00,
    0x00, 0x00, 0x00, 0x00, 0x00, 0x00, 0x00, 0x00, 0x00, 0x00, 0x00, 0x00, 0x00, 0x00, 0x00, 0x00,
    0x00, 0x00, 0x00, 0x00, 0x00, 0x00, 0x00, 0x00, 0x00, 0x00, 0x00, 0x00, 0x00, 0x00, 0x00, 0x00,
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    0x00, 0x00, 0x00, 0x00, 0x00, 0x00, 0x00, 0x00, 0x00, 0x00, 0x00, 0x00, 0x00, 0x00, 0x00, 0x00
};

static const unsigned char* const gif0_frames[] PROGMEM = {
    gif0_f0, gif0_f1, gif0_f2, gif0_f3, gif0_f4, gif0_f5
};
#define GIF0_FRAMES 6

// ── GIF 1: R0C1 — Bongo cat (2 frames, keypress-driven) ───────────────────
static const unsigned char PROGMEM gif1_f0[] = {
    0x00,0x00,0x00,0x00,0x00,0x00,0x00,0x00,0x00,0x00,0x00,0x00,0x00,0x00,0x00,0x00,
    0x00,0x00,0x00,0x00,0x00,0x00,0x00,0x00,0x00,0x00,0x00,0x00,0x00,0x00,0x00,0x00,
    0x00,0x00,0x00,0x00,0x00,0x00,0x00,0x03,0x00,0x00,0x00,0x00,0x00,0x00,0x00,0x00,
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    0x00,0x00,0x00,0x00,0x00,0x00,0x00,0x00,0x00,0x00,0x00,0x00,0x00,0x00,0x00,0x00
};

static const unsigned char PROGMEM gif1_f1[] = {
    0x00,0x00,0x00,0x00,0x00,0x00,0x00,0x00,0x00,0x00,0x00,0x00,0x00,0x00,0x00,0x00,
    0x00,0x00,0x00,0x00,0x00,0x00,0x00,0x00,0x00,0x00,0x00,0x00,0x00,0x00,0x00,0x00,
    0x00,0x00,0x00,0x00,0x00,0x00,0x00,0x03,0x00,0x00,0x00,0x00,0x00,0x00,0x00,0x00,
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    0x00,0x00,0x00,0x00,0x00,0x00,0x00,0x00,0x00,0x00,0x00,0x00,0x00,0x00,0x00,0x00
};

// ── GIF 2: R1C0 — text animation (4 frames, 3fps) ─────────────────────────
static const unsigned char PROGMEM gif2_f0[] = {
    0x00,0x00,0x00,0x00,0x00,0x00,0x00,0x00,0x00,0x00,0x00,0x00,0x00,0x00,0x00,0x00,
    0x00,0x00,0x00,0x00,0x00,0x00,0x00,0x00,0x00,0x00,0x00,0x00,0x00,0x00,0x00,0x00,
    0x00,0x00,0x00,0x00,0x00,0x00,0x00,0x00,0x00,0x00,0x00,0x00,0x00,0x00,0x00,0x00,
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    0x00,0x00,0x00,0x00,0x00,0x00,0x00,0x00,0x00,0x00,0x00,0x00,0x00,0x00,0x00,0x00
};

static const unsigned char PROGMEM gif2_f1[] = {
    0x00,0x00,0x00,0x00,0x00,0x00,0x00,0x00,0x00,0x00,0x00,0x00,0x00,0x00,0x00,0x00,
    0x00,0x00,0x00,0x00,0x00,0x00,0x00,0x00,0x00,0x00,0x00,0x00,0x00,0x00,0x00,0x00,
    0x00,0x00,0x00,0x00,0x00,0x00,0x00,0x00,0x00,0x00,0x00,0x00,0x00,0x00,0x00,0x00,
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    0x00,0x00,0x00,0x00,0x00,0x00,0x00,0x00,0x00,0x00,0x00,0x00,0x00,0x00,0x00,0x00
};

static const unsigned char PROGMEM gif2_f2[] = {
    0x00,0x00,0x00,0x00,0x00,0x00,0x00,0x00,0x00,0x00,0x00,0x00,0x00,0x00,0x00,0x00,
    0x00,0x00,0x00,0x00,0x00,0x00,0x00,0x00,0x00,0x00,0x00,0x00,0x00,0x00,0x00,0x00,
    0x00,0x00,0x00,0x00,0x00,0x00,0x00,0x00,0x00,0x00,0x00,0x00,0x00,0x00,0x00,0x00,
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    0x00,0x00,0x00,0x00,0x00,0x00,0x00,0x00,0x00,0x00,0x00,0x00,0x00,0x00,0x00,0x00
};

static const unsigned char PROGMEM gif2_f3[] = {
    0x00,0x00,0x00,0x00,0x00,0x00,0x00,0x00,0x00,0x00,0x00,0x00,0x00,0x00,0x00,0x00,
    0x00,0x00,0x00,0x00,0x00,0x00,0x00,0x00,0x00,0x00,0x00,0x00,0x00,0x00,0x00,0x00,
    0x00,0x00,0x00,0x00,0x00,0x00,0x00,0x00,0x00,0x00,0x00,0x00,0x00,0x00,0x00,0x00,
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    0x00,0x00,0x00,0x00,0x00,0x00,0x00,0x00,0x00,0x00,0x00,0x00,0x00,0x00,0x00,0x00
};

static const unsigned char* const gif2_frames[] PROGMEM = {
    gif2_f0, gif2_f1, gif2_f2, gif2_f3
};
#define GIF2_FRAMES 4

// ── GIF 3: R1C1 — Anydesk static (1 frame) ────────────────────────────────
static const unsigned char PROGMEM gif3_f0[] = {
    0x00,0x00,0x00,0x00,0x00,0x00,0x00,0x00,0x00,0x00,0x00,0x00,0x00,0x00,0x00,0x00,
    0x00,0x00,0x00,0x00,0x00,0x00,0x00,0x00,0x00,0x00,0x00,0x00,0x00,0x00,0x00,0x00,
    0x00,0x00,0x00,0x00,0x00,0x00,0x00,0x00,0x00,0x00,0x00,0x00,0x00,0x00,0x00,0x00,
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    0x00,0x00,0x00,0x00,0x00,0x00,0x00,0x00,0x00,0x00,0x00,0x00,0x00,0x00,0x00,0x00
};


// ═══════════════════════════════════════════════════════════════════════════
//  KEYMAP
// ═══════════════════════════════════════════════════════════════════════════
const uint16_t PROGMEM keymaps[][MATRIX_ROWS][MATRIX_COLS] = {

    // ── Layer 0: MEDIA ──────────────────────────────────────────────────
    //  R0C0=Browser  R0C1=VSCode  R0C2=Enc.Btn(mute)
    //  R1C0=BT       R1C1=AnyDsk  R1C2=LayerToggle
    [_MEDIA] = LAYOUT(
        KC_WWW_HOME,  LGUI(KC_GRV),  KC_MUTE,
        KC_F1,        KC_F2,         KC_LAYER_TOG
    ),

    // ── Layer 1: GIF ────────────────────────────────────────────────────
    //  GIF buttons; R0C2 encoder btn = stop current gif
    //  R1C2 = toggle back to layer 0
    [_GIF] = LAYOUT(
        KC_NO,  KC_NO,  KC_MUTE,
        KC_NO,  KC_NO,  KC_LAYER_TOG
    ),
};


// ═══════════════════════════════════════════════════════════════════════════
//  CUSTOM KEYCODE HANDLER
// ═══════════════════════════════════════════════════════════════════════════
bool process_record_user(uint16_t keycode, keyrecord_t *record) {
    uint8_t row = record->event.key.row;
    uint8_t col = record->event.key.col;

    // ── Layer toggle (capslock style) ──────────────────────────────────
    if (keycode == KC_LAYER_TOG) {
        if (record->event.pressed) {
            if (IS_LAYER_ON(_GIF)) {
                layer_off(_GIF);
                active_gif     = -1;   // stop all GIFs when leaving layer
                bongo_other_pressed = false;
            } else {
                layer_on(_GIF);
            }
        }
        return false;
    }

    // ── GIF layer key handling ─────────────────────────────────────────
    if (IS_LAYER_ON(_GIF)) {
        if (record->event.pressed) {
            // Determine which GIF to trigger
            int8_t new_gif = -1;
            if      (row == 0 && col == 0) new_gif = 0;  // walking anim
            else if (row == 0 && col == 1) new_gif = 1;  // bongo cat
            else if (row == 1 && col == 0) new_gif = 2;  // text scroll
            else if (row == 1 && col == 1) new_gif = 3;  // anydesk static

            if (new_gif >= 0) {
                if (active_gif == new_gif) {
                    // Same button pressed again → stop
                    active_gif = -1;
                    bongo_other_pressed = false;
                } else {
                    active_gif = new_gif;
                    frame_idx  = 0;
                    last_frame_t = timer_read32();
                    // Track bongo "other" state
                    bongo_other_pressed = (new_gif != 1 && active_gif == 1);
                }
                oled_clear();
            }
        } else {
            // Key released
            if (row == 0 && col == 1) {
                // R0C1 released → bongo back to idle frame if active
            }
            // If any non-R0C1 key released while bongo is active
            if (active_gif == 1 && !(row == 0 && col == 1)) {
                bongo_other_pressed = false;
            }
        }
    }

    // Track bongo "other button pressed" while bongo gif is active
    if (active_gif == 1 && IS_LAYER_ON(_GIF)) {
        if (record->event.pressed && !(row == 0 && col == 1)) {
            bongo_other_pressed = true;
        }
        if (!record->event.pressed && !(row == 0 && col == 1)) {
            bongo_other_pressed = false;
        }
    }

    return true;
}


// ═══════════════════════════════════════════════════════════════════════════
//  ENCODER
//  CW  (clockwise)        = Volume Up
//  CCW (counter-clockwise) = Volume Down
// ═══════════════════════════════════════════════════════════════════════════
#ifdef ENCODER_ENABLE
bool encoder_update_user(uint8_t index, bool clockwise) {
    if (clockwise) {
        tap_code(KC_VOLU);
    } else {
        tap_code(KC_VOLD);
    }
    return false;
}
#endif


// ═══════════════════════════════════════════════════════════════════════════
//  OLED
// ═══════════════════════════════════════════════════════════════════════════
#ifdef OLED_ENABLE
oled_rotation_t oled_init_user(oled_rotation_t rotation) {
    return OLED_ROTATION_0;
}

static void draw_frame(const unsigned char *frame) {
    oled_write_raw_P(frame, 128 * 4);  // 128×32 = 512 bytes
}

bool oled_task_user(void) {
    uint32_t now = timer_read32();

    if (active_gif < 0) {
        // ── No GIF active — show layer name ──────────────────────────
        oled_clear();
        if (IS_LAYER_ON(_GIF)) {
            oled_write_P(PSTR("  GIF LAYER  "), false);
        } else {
            oled_write_P(PSTR("  MEDIA LAYER"), false);
        }
        return false;
    }

    // ── GIF 0: walking character, 6 frames, 3fps ─────────────────────
    if (active_gif == 0) {
        if (timer_elapsed32(last_frame_t) >= ANIM_MS) {
            frame_idx = (frame_idx + 1) % GIF0_FRAMES;
            last_frame_t = now;
            oled_clear();
        }
        draw_frame((const unsigned char *)pgm_read_ptr(&gif0_frames[frame_idx]));
    }

    // ── GIF 1: bongo cat, keypress-driven ────────────────────────────
    else if (active_gif == 1) {
        uint8_t show_frame = bongo_other_pressed ? 1 : 0;
        draw_frame(show_frame == 0 ? gif1_f0 : gif1_f1);
    }

    // ── GIF 2: text scroll, 4 frames, 3fps ───────────────────────────
    else if (active_gif == 2) {
        if (timer_elapsed32(last_frame_t) >= ANIM_MS) {
            frame_idx = (frame_idx + 1) % GIF2_FRAMES;
            last_frame_t = now;
            oled_clear();
        }
        draw_frame((const unsigned char *)pgm_read_ptr(&gif2_frames[frame_idx]));
    }

    // ── GIF 3: anydesk, static ───────────────────────────────────────
    else if (active_gif == 3) {
        draw_frame(gif3_f0);
    }

    return false;
}
#endif
